## conf/layer.conf
```bitbake
# Board specific layer configuration for meta-mender

# We have a conf and classes directory, add to BBPATH
BBPATH .= ":${LAYERDIR}"

# We have recipes-* directories, add to BBFILES
BBFILES += "${LAYERDIR}/recipes-*/*/*.bb \
	${LAYERDIR}/recipes-*/*/*.bbappend"

BBFILE_COLLECTIONS += "meta-mender-clearfog"
BBFILE_PATTERN_meta-mender-clearfog = "^${LAYERDIR}/"
BBFILE_PRIORITY_meta-mender-clearfog = "10"

LAYERDEPENDS_meta-mender-clearfog = "mender clearfog"

LAYERSERIES_COMPAT_meta-mender-clearfog = "warrior zeus dunfell"

MENDER_FEATURES_ENABLE_append = " mender-uboot mender-image-sd"
MENDER_FEATURES_DISABLE_append = " mender-grub mender-image-uefi"
```

## conf/machine/clearfog.conf
```bitbake
#@TYPE: Machine
#@NAME: SolidRun ClearFog
#@SOC: Armada 38x
#@DESCRIPTION: Machine configuration for SolidRun ClearFog

#Note: Added here because these settings are also required by mender u-boot.

require conf/machine/include/clearfog-common.inc
```

## conf/machine/include/clearfog-common.inc
```bitbake
# Have to manually specify the DTB file to use with Mender
# 
#    armada-388-clearfog.dtb        - Clearfog
#    armada-388-clearfog-base.dtb   - Clearfog Base
#    armada-388-clearfog-pro.dtb    - Clearfog Pro
#    armada-388-clearfog-gtr-s4.dtb - Clearfog GTR S4
#    armada-388-clearfog-gtr-l8.dtb - Clearfog GTR L8
#
MENDER_DTB_NAME_FORCE ?= "armada-388-clearfog.dtb"

# Depending on which boot medium is selected the U-boot binary will change name
#
#    u-boot-spl-mmc.kwb
#    u-boot-spl-nand.kwb"
#    u-boot-spl-sata.kwb"
#    u-boot-spl-sdhc.kwb"
#    u-boot-spl-spi.kwb
#
# Update this variable to change boot location, it will update
# MVEBU_SPL_BOOT_DEVICE_XXX
UBOOT_BINARY ?= "u-boot-spl-sdhc.kwb"

WKS_FILE = "clearfog.wks"
WKS_FILE_DEPENDS = "virtual/bootloader clearfog-u-boot-scr"
```

## meta-mender-clearfog/conf/machine/clearfog-base.conf
```bitbake
#@TYPE: Machine
#@NAME: SolidRun ClearFog Base
#@SOC: Armada 38x
#@DESCRIPTION: Machine configuration for SolidRun ClearFog Base

#Note: Added here because these settings are also required by mender u-boot.

KERNEL_DEVICETREE_clearfog = " \
	armada-388-clearfog-base.dtb \
	"

require conf/machine/include/clearfog-common.inc
```

## meta-mender-clearfog/conf/machine/clearfog-gtr-l8.conf
```bitbake
#@TYPE: Machine
#@NAME: SolidRun ClearFog GTR L8
#@SOC: Armada 38x
#@DESCRIPTION: Machine configuration for SolidRun ClearFog GTR L8

#Note: Added here because these settings are also required by mender u-boot.

KERNEL_DEVICETREE_clearfog-gtr-l8 = " \
	armada-385-clearfog-gtr-l8.dtb \
	"

require conf/machine/include/clearfog-common.inc
```

## meta-mender-clearfog/conf/machine/clearfog-gtr-s4.conf
```bitbake
#@TYPE: Machine
#@NAME: SolidRun ClearFog GTR S4
#@SOC: Armada 38x
#@DESCRIPTION: Machine configuration for SolidRun ClearFog GTR S4

#Note: Added here because these settings are also required by mender u-boot.

KERNEL_DEVICETREE_clearfog-gtr-s4 = " \
	armada-385-clearfog-gtr-s4.dtb \
	"

require conf/machine/include/clearfog-common.inc
```

## meta-mender-clearfog/conf/machine/clearfog-pro.conf
```bitbake
#@TYPE: Machine
#@NAME: SolidRun ClearFog Pro
#@SOC: Armada 38x
#@DESCRIPTION: Machine configuration for SolidRun ClearFog Pro

#Note: Added here because these settings are also required by mender u-boot.

KERNEL_DEVICETREE_clearfog = " \
	armada-388-clearfog-pro.dtb \
	"

require conf/machine/include/clearfog-common.inc
```

## meta-mender-clearfog/conf/machine/clearfog.conf
```bitbake
#@TYPE: Machine
#@NAME: SolidRun ClearFog
#@SOC: Armada 38x
#@DESCRIPTION: Machine configuration for SolidRun ClearFog

#Note: Added here because these settings are also required by mender u-boot.

KERNEL_DEVICETREE_clearfog = " \
	armada-388-clearfog-base.dtb \
	armada-388-clearfog-pro.dtb \
	armada-388-clearfog.dtb \
	"

KERNEL_DEVICETREE_clearfog-gtr-s4 = " \
	armada-385-clearfog-gtr-s4.dtb \
	"

KERNEL_DEVICETREE_clearfog-gtr-l8 = " \
	armada-385-clearfog-gtr-l8.dtb \
	"

require conf/machine/include/clearfog-common.inc
```

## meta-mender-clearfog/conf/machine/include/clearfog-common.inc
```bitbake
# Depending on which boot medium is selected the U-boot binary will change name
#
#    u-boot-spl-mmc.kwb
#    u-boot-spl-nand.kwb"
#    u-boot-spl-sata.kwb"
#    u-boot-spl-sdhc.kwb"
#    u-boot-spl-spi.kwb
#
# Update this variable to change boot location, it will update
# MVEBU_SPL_BOOT_DEVICE_XXX
UBOOT_BINARY ?= "u-boot-spl-sdhc.kwb"

WKS_FILE = "clearfog.wks"
WKS_FILE_DEPENDS = "virtual/bootloader clearfog-u-boot-scr"
```

## wic/clearfog.wks
```
# short-description: Create SD card image with a boot partition
# long-description:
# Create an image that can be written onto a SD card using dd for use with clearfog machine.
#
part /boot --source bootimg-partition --ondisk sda --fstype=vfat --label boot --active --align 4096 --size 16M --extra-space 0
part / --source rootfs --ondisk mmcblk --fstype=ext4 --label root --align 4096

bootloader --ptable msdos
```
